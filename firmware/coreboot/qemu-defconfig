## firmware/coreboot/qemu-defconfig
```kconfig
CONFIG_ANY_TOOLCHAIN=y
CONFIG_BOARD_EMULATION_QEMU_X86_I440FX=y
CONFIG_PAYLOAD_SEABIOS=y
CONFIG_SEABIOS_STABLE=y
CONFIG_CONSOLE_SERIAL=y
CONFIG_DEFAULT_CONSOLE_LOGLEVEL_8=y
```
